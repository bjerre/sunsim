## main/Kconfig.projbuild
```kconfig
menu "Sunsim Configuration"

    config SUNSIM_PRIMARY_CHANNEL
        int "Zigbee primary channel"
        range 11 26
        default 13
        help
            Zigbee channel sunsim forms its network on.

    config SUNSIM_SECONDARY_CHANNEL_MASK
        hex "Zigbee secondary channel mask"
        default 0x07FFF800
        help
            Fallback channel mask used if the primary channel is unusable.

    config SUNSIM_WIFI_SSID
        string "Wi-Fi SSID (used once at boot to sync time over SNTP)"
        default ""

    config SUNSIM_WIFI_PASSWORD
        string "Wi-Fi password"
        default ""

    config SUNSIM_TZ
        string "POSIX TZ string for local time"
        default "UTC0"
        help
            Determines the local time the daylight/work-light schedule runs on.
            Examples: "UTC0", "EST5EDT,M3.2.0/2,M11.1.0/2" (US Eastern, with DST),
            "CET-1CEST,M3.5.0,M10.5.0/3" (Central Europe, with DST).

    config SUNSIM_LATITUDE_DEG
        string "Latitude in decimal degrees (positive = North)"
        default "0.0"
        help
            Used to compute real sunrise/sunset times for the wall bulbs'
            daylight curve. Left at 0.0 (the equator), sunrise/sunset land
            close to 06:00/18:00 year-round. Example: "55.6761" for Copenhagen.

    config SUNSIM_LONGITUDE_DEG
        string "Longitude in decimal degrees (positive = East)"
        default "0.0"
        help
            Used together with SUNSIM_TZ to compute real sunrise/sunset
            times. Left at 0.0 (the Greenwich meridian), only the UTC offset
            from SUNSIM_TZ affects the result. Example: "12.5683" for
            Copenhagen.

    config SUNSIM_DEBUG_FAST_DAY
        bool "Debug: boot in fast-day mode"
        default n
        help
            Fast-day mode is for bench-testing without waiting for a real
            sunrise/sunset: the daylight program runs one active window
            (the `config hours`, e.g. 08:00-19:00, on the next active day -
            off hours and weekends are skipped) every
            SUNSIM_DEBUG_DAY_SECONDS of real time, looping, and updates the
            lights every second so the gradient visibly animates. Switch it
            at runtime with the console's `fastday on|off`; this only picks
            how the board boots.

    config SUNSIM_DEBUG_DAY_SECONDS
        int "Debug: real seconds per simulated day in fast-day mode"
        range 10 3600
        default 120
        help
            The default for `fastday on` (and for booting in fast-day mode).

    menu "Status display"

        config SUNSIM_DISPLAY
            bool "Show status on the board's ST7789 LCD"
            default y
            help
                Time, day length, next sunrise/sunset, mode and device
                links on the on-board LCD. Defaults match the Waveshare
                ESP32-C6-GEEK (1.14" ST7789, 240x135).

        config SUNSIM_DISPLAY_PIN_SCLK
            int "SCLK GPIO"
            depends on SUNSIM_DISPLAY
            default 1
        config SUNSIM_DISPLAY_PIN_MOSI
            int "MOSI GPIO"
            depends on SUNSIM_DISPLAY
            default 2
        config SUNSIM_DISPLAY_PIN_DC
            int "DC GPIO"
            depends on SUNSIM_DISPLAY
            default 3
        config SUNSIM_DISPLAY_PIN_RST
            int "RST GPIO"
            depends on SUNSIM_DISPLAY
            default 4
        config SUNSIM_DISPLAY_PIN_CS
            int "CS GPIO"
            depends on SUNSIM_DISPLAY
            default 5
        config SUNSIM_DISPLAY_PIN_BL
            int "Backlight GPIO"
            depends on SUNSIM_DISPLAY
            default 6

        config SUNSIM_DISPLAY_FLIP
            bool "Rotate the picture 180 degrees"
            depends on SUNSIM_DISPLAY
            default n
            help
                Landscape either way round; pick whichever is upright with
                the board's USB plug where you hold it.

    endmenu

endmenu
```
